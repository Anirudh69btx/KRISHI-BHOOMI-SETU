/*
 * FLIP Sensor Node DTS - LoRa SX1262 Definition
 * Target: ESP32-C3
 */

/ {
	aliases {
		lora0 = &sx1262;
		lora-sx1262 = &sx1262;
	};
};

&spi2 {
	status = "okay";
	#address-cells = <1>;
	#size-cells = <0>;

	cs-gpios = <&gpio0 10 GPIO_ACTIVE_LOW>;

	sx1262: sx1262@0 {
		compatible = "semtech,sx1262";
		reg = <0>;
		spi-max-frequency = <10000000>;
		reset-gpios = <&gpio0 19 GPIO_ACTIVE_LOW>;
		busy-gpios = <&gpio0 18 GPIO_ACTIVE_HIGH>;
		dio1-gpios = <&gpio0 9 GPIO_ACTIVE_HIGH>;
		dio2-tx-enable;
		status = "okay";
	};
};
